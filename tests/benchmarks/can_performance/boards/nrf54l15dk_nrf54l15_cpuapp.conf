## tests/benchmarks/can_performance/testcase.yaml
```yaml
common:
  tags:
    - drivers
    - can
    - ci_tests_benchmarks_can_performance
  depends_on: can
  filter: dt_chosen_enabled("zephyr,canbus")
  timeout: 600
  sysbuild: true

tests:
  benchmarks.can_performance.manual:
    build_only: true
    integration_platforms:
      - nrf54h20dk/nrf54h20/cpuapp
    platform_allow:
      - nrf54h20dk/nrf54h20/cpuapp

  benchmarks.can_performance.cpu_load:
    extra_configs:
      - CONFIG_CPU_LOAD=y
      - CONFIG_CAN_PERF_SHORT_RUN=y
    harness: console
    harness_config:
      type: multi_line
      ordered: false
      regex:
        - "Measured CPU load:"
        - "Done"
    integration_platforms:
      - nrf54h20dk/nrf54h20/cpuapp
    platform_allow:
      - nrf54h20dk/nrf54h20/cpuapp

  benchmarks.can_performance.current_consumption:
    tags:
      - ppk_power_measure
    extra_configs:
      - CONFIG_CPU_LOAD=n
      - CONFIG_CAN_PERF_DEAD_TIME_MS=100
      - CONFIG_CAN_PERF_SHORT_RUN=y
      - CONFIG_PRINTK=n
      - CONFIG_CONSOLE=n
      - CONFIG_UART_CONSOLE=n
      - CONFIG_SERIAL=n
      - CONFIG_BOOT_BANNER=n
      - CONFIG_NCS_BOOT_BANNER=n
    harness: pytest
    harness_config:
      fixture: ppk_power_measure
      pytest_root:
        - "${CUSTOM_ROOT_TEST_DIR}/test_measure_power_consumption.py::test_measure_can_performance"
    integration_platforms:
      - nrf54h20dk/nrf54h20/cpuapp
    platform_allow:
      - nrf54h20dk/nrf54h20/cpuapp
```

## tests/zephyr/drivers/can/api/nrf_scan/testcase.yaml
```yaml
common:
  tags:
    - drivers
    - can
  depends_on: can
  harness: ztest
  harness_config:
    fixture: nrf-scan
  filter: dt_chosen_exists("zephyr,canbus") and dt_compat_enabled("nordic,nrf-scan")
  platform_allow:
    - nrf54l15dk/nrf54l15/cpuapp
  integration_platforms:
    - nrf54l15dk/nrf54l15/cpuapp
tests:
  nrf.extended.drivers.can.api.nrf_scan: {}
  nrf.extended.drivers.can.api.nrf_scan.pm:
    extra_configs:
      - CONFIG_PM_DEVICE=y
      - CONFIG_PM_DEVICE_RUNTIME=y
```
