/*
 * Copyright (c) 2026 Nordic Semiconductor ASA
 *
 * SPDX-License-Identifier: LicenseRef-Nordic-5-Clause
 */

/ {
	/*
	 * Redefine sw0/button0 to use SPI SCK - P0.00
	 * Thus, when "remote" starts SPI transfer, there will be gpio interrupt,
	 * the same as originally triggered by sw0 button.
	 */
	buttons {
		compatible = "gpio-keys";

		button0: button_0 {
			gpios = <&gpio0 0 (GPIO_PULL_UP | GPIO_ACTIVE_LOW)>;
			label = "Push button 0";
			zephyr,code = <INPUT_KEY_0>;
		};
	};

	aliases {
		/* GPIO P0.11 is used by "remote" at cpurad */
		/delete-property/ sw3;
	};
};

/delete-node/ &button3;
